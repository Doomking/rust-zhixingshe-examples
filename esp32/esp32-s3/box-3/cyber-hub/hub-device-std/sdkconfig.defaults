## esp32/esp32-s3/box-3/cyber-hub/hub-device-std/sdkconfig.defaults
```kconfig
CONFIG_ESP_MAIN_TASK_STACK_SIZE=30720
CONFIG_PTHREAD_TASK_STACK_SIZE_DEFAULT=8192
CONFIG_FREERTOS_HZ=1000
CONFIG_ESP_DEFAULT_CPU_FREQ_MHZ_240=y
CONFIG_ESP_DEFAULT_CPU_FREQ_MHZ=240
CONFIG_ESP32S3_DEFAULT_CPU_FREQ_240=y
CONFIG_ESP32S3_DEFAULT_CPU_FREQ_MHZ=240

# Flash and Partition Table (16MB, custom with model partition)
CONFIG_ESPTOOLPY_FLASHSIZE_16MB=y
CONFIG_ESPTOOLPY_FLASHSIZE="16MB"

# SPIRAM and Performance
CONFIG_SPIRAM=y
CONFIG_SPIRAM_USE=y
CONFIG_SPIRAM_USE_MALLOC=y
CONFIG_SPIRAM_BOOT_INIT=y
CONFIG_SPIRAM_MODE_OCT=y
CONFIG_SPIRAM_SPEED_80M=y
CONFIG_SPIRAM_ALLOW_BSS_SEG_EXTERNAL_MEMORY=y

# ESP-SR specific AI Models
CONFIG_SR_NSN_NSNET2=y
CONFIG_SR_VADN_VADNET1_MEDIUM=y
CONFIG_SR_WN_WN9_HIESP=y

# Audio Performance
CONFIG_ESP_WIFI_IRAM_OPT=y
CONFIG_ESP_WIFI_RX_IRAM_OPT=y

# VFS and common
CONFIG_VFS_MAX_COUNT=20
CONFIG_SPIRAM_MALLOC_ALWAYSINTERNAL=8

# Task Watchdog: increase timeout for AFE audio processing
CONFIG_ESP_TASK_WDT_TIMEOUT_S=10

# SNTP for time sync
CONFIG_LWIP_SNTP_MAX_SERVERS=1
```

## esp32/esp32-s3/box-3/liquid-stream/sdkconfig.defaults
```kconfig
CONFIG_ESP_MAIN_TASK_STACK_SIZE=30720
CONFIG_PTHREAD_TASK_STACK_SIZE_DEFAULT=8192
CONFIG_FREERTOS_HZ=1000
CONFIG_ESP_DEFAULT_CPU_FREQ_MHZ_240=y
CONFIG_ESP_DEFAULT_CPU_FREQ_MHZ=240
CONFIG_ESP32S3_DEFAULT_CPU_FREQ_240=y
CONFIG_ESP32S3_DEFAULT_CPU_FREQ_MHZ=240

# Flash
CONFIG_ESPTOOLPY_FLASHSIZE_16MB=y
CONFIG_ESPTOOLPY_FLASHSIZE="16MB"

# SPIRAM and Performance (Crucial for Fluid Engine)
CONFIG_SPIRAM=y
CONFIG_SPIRAM_USE=y
CONFIG_SPIRAM_USE_MALLOC=y
CONFIG_SPIRAM_BOOT_INIT=y
CONFIG_SPIRAM_MODE_OCT=y
CONFIG_SPIRAM_SPEED_80M=y
CONFIG_SPIRAM_ALLOW_BSS_SEG_EXTERNAL_MEMORY=y

# FPU & Optimizations 
CONFIG_COMPILER_OPTIMIZATION_PERF=y
CONFIG_COMPILER_CXX_EXCEPTIONS=n

CONFIG_VFS_MAX_COUNT=20
CONFIG_SPIRAM_MALLOC_ALWAYSINTERNAL=8
```
